/**********************************************************************************************************
*文件说明：Mavlink串口实现
*实现功能：实现串口读写
*修改日期：2018-12-8
*修改作者：crystal cup
*修改备注：
**********************************************************************************************************/

#include "mavlink_usart_fifo.h"
#include "copter.h"



fifo_t uart_rx_fifo, uart_tx_fifo;
uint8_t uart_tx_buf[UART_TX_BUFFER_SIZE], uart_rx_buf[UART_RX_BUFFER_SIZE];



/**********************************************************************************************************
*函数原型: uint8_t fifo_read_ch(fifo_t* fifo, uint8_t* ch)
*函数功能: 读FIFO
*输入参数: fifo 待读缓冲区
*返回数据: *ch   读到的数据
*修改日期: 2018-11-17
*备注信息： 正确读取，1； 无数据，0
**********************************************************************************************************/

uint8_t fifo_read_ch(fifo_t* fifo, uint8_t* ch)
{
	if(fifo->tail == fifo->head) return false;
	*ch = fifo->buf[fifo->tail];  
	
	if(++fifo->tail >= fifo->length) fifo->tail = 0;
  return true;
}

/**********************************************************************************************************
*函数原型: uint8_t fifo_write_ch(fifo_t* fifo, uint8_t ch)
*函数功能: 写一字节数据到FIFO 
*输入参数: fifo 待写入缓冲区
*返回数据: *ch   读到的数据
*修改日期: 2018-11-17
*备注信息：正确读取，1； 无数据，0
**********************************************************************************************************/

uint8_t fifo_write_ch(fifo_t* fifo, uint8_t ch)
{
	uint16_t h = fifo->head;
	
	if(++h >= fifo->length) h = 0;
	if(h == fifo->tail) return false;
	
	fifo->buf[fifo->head] = ch;
	fifo->head = h;
  return true;
}

/**********************************************************************************************************
*函数原型: uint16_t fifo_free(fifo_t* fifo)  
*函数功能: 返回缓冲区剩余字节长度
*输入参数: fifo 待读缓冲区
*返回数据: 剩余空间
*修改日期: 2018-11-17
*备注信息： 剩余字节长度大于等于2时，才可写入数据
**********************************************************************************************************/

uint16_t fifo_free(fifo_t* fifo)  
{
	uint16_t free;
	
	if(fifo->head >= fifo->tail) free = fifo->tail + (fifo->length - fifo->head);
	else free = fifo->tail - fifo->head;
	
  return free;
}

/**********************************************************************************************************
*函数原型: uint16_t fifo_used(fifo_t* fifo)
*函数功能: 
*输入参数: 
*返回数据: 
*修改日期: 2018-11-17
*备注信息： 正确读取，1； 无数据，0
**********************************************************************************************************/
uint16_t fifo_used(fifo_t* fifo)
{
	uint16_t used;
	
	if(fifo->head >= fifo->tail) used = fifo->head - fifo->tail;
	else used = fifo->head + (fifo->length - fifo->tail);
	
	return used;	
}

/**********************************************************************************************************
*函数原型: void fifo_init(fifo_t* fifo, uint8_t* buf, uint16_t length)  
*函数功能: 初始化缓冲区
*输入参数: fifo 待读缓冲区
*返回数据: *ch   读到的数据
*修改日期: 2018-11-17
*备注信息： 正确读取，1； 无数据，0
**********************************************************************************************************/

void fifo_init(fifo_t* fifo, uint8_t* buf, uint16_t length)  
{
	uint16_t i;
	
	fifo->buf = buf;
	fifo->length = length;
	fifo->head = 0;
	fifo->tail = 0;
	
	for(i=0; i<length; i++) fifo->buf[i] = 0;	
}

/**********************************************************************************************************
*函数原型: uint8_t serial_write_buf(uint8_t* buf, uint16_t length) 
*函数功能: 写数据到串口，启动发射
*输入参数: 
*返回数据: 
*修改日期: 2018-11-17
*备注信息：数据写入发射缓冲区后，启动发射中断，在中断程序，数据自动发出
**********************************************************************************************************/


uint8_t serial_write_buf(uint8_t* buf, uint16_t length) 
{
	uint16_t i;
	
	if(length == 0) return false;
    for(i = 0; length > 0; length--, i++)	
	{
		fifo_write_ch(&uart_tx_fifo, buf[i]);
	}	

	USART2->CR1|=1<<7;  	//串口中断发送使能 
	
	return true;
}

/**********************************************************************************************************
*函数原型: uint8_t serial_read_ch(void)
*函数功能: 自串口读数据 
*输入参数: fifo 待读缓冲区
*返回数据: *ch   读到的数据
*修改日期: 2018-11-17
*备注信息： 一字节数据
**********************************************************************************************************/

uint8_t serial_read_ch(void)
{
	uint8_t ch;	
	fifo_read_ch(&uart_rx_fifo, &ch);	
	return ch;
}

/**********************************************************************************************************
*函数原型: uint16_t serial_free(void)
*函数功能: 释放
*输入参数: fifo 待读缓冲区
*返回数据: 
*修改日期: 2018-11-17
*备注信息： 检测发射缓冲区剩余字节长度  剩余字节长度
**********************************************************************************************************/

uint16_t serial_free(void)
{
	return fifo_free(&uart_tx_fifo);
}

/**********************************************************************************************************
*函数原型: uint16_t serial_available(void)
*函数功能: 串口有效
*输入参数: 
*返回数据: 
*修改日期: 2018-11-17
*备注信息：
**********************************************************************************************************/
uint16_t serial_available(void)
{
	return fifo_used(&uart_rx_fifo);
}



/***********************************************************************************************************
*                               NoneQuadrotor UAV file_end
***********************************************************************************************************/
