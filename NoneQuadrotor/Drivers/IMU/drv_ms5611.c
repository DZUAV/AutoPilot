/**********************************************************************************************************
*文件说明：ms5611动文件
*实现功能：配置icm20602
*修改日期：2018-11-26
*修改作者：
*修改备注：
**********************************************************************************************************/
#include "drv_ms5611.h"
#include "copter.h"
int32_t ms5611_pressure;

int32_t baroAlt,baroAltOld;
float baro_alt_speed;
int32_t baro_Offset;
uint32_t ms5611_ut;              // 静态温度测量结果
uint32_t ms5611_up;             // 静态压力测量结果
uint16_t ms5611_prom[PROM_NB];  // on-chip ROM
uint8_t temp_rxbuf[3],press_rxbuf[3];

/*====================================================================================================*/
/*====================================================================================================*
**函数原型 : void MS5611_Init(void)
**功    能 : 压力开始转换
**输    入 : None
**输    出 : None
**备    注 : 
**====================================================================================================*/
/*====================================================================================================*/
u8 ms5611_ok; //传感器是否是好的
void MS5611_Init(void)
{
	delay_ms(10);
	//传感器复位
	MS5611_Reset();
	delay_ms(3);
	ms5611_ok = !( MS5611_Read_Prom() );
	//开始读取温度
	MS5611_Start_Temperature();
}

/*====================================================================================================*/
/*====================================================================================================*
**函数原型 : int MS5611_Update(void)
**功    能 : 更新
**输    入 : None
**输    出 : None
**备    注 : 
**====================================================================================================*/
/*====================================================================================================*/
int MS5611_Update(void)
{
	static int state = 0;
	
	if (state) 
	{
			MS5611_Read_Adc_Pressure();
			MS5611_Start_Temperature();
			MS5611_BaroAltCalculate();
			state = 0;
	} 
	else 
	{
			MS5611_Read_Adc_Temperature();
			MS5611_Start_Press();
			state = 1;
	}
	return (state);
}


/*====================================================================================================*/
/*====================================================================================================*
**函数原型 : void MS5611_Reset(void)
**功    能 : MS5611复位
**输    入 : None
**输    出 : None
**备    注 : uint8_t MS5611_WriteRegister(uint8_t reg,uint8_t data);
uint8_t MS5611_ReadRegister(uint8_t reg, uint8_t *data,uint8_t length);
**====================================================================================================*/
/*====================================================================================================*/
void MS5611_Reset(void)
{
      MS5611_WriteRegister(CMD_RESET, 1);
	  delay_ms(2800);
}


/*====================================================================================================*/
/*====================================================================================================*
**函数原型 : u8 MS5611_Read_Prom(void)
**功    能 : MS5611读取内部ROM
**输    入 : None
**输    出 : None
**备    注 : 
**====================================================================================================*/
/*====================================================================================================*/
u8 MS5611_Read_Prom(void)
{
	uint8_t rxbuf[2] = { 0, 0 };
	u8 check = 0;
	u8 i;

	for (i = 0; i < PROM_NB; i++)
	{
		check += MS5611_ReadRegister(CMD_PROM_RD + i * 2, rxbuf,2); // send PROM READ command
		ms5611_prom[i] = rxbuf[0] << 8 | rxbuf[1];
	}

	if(check==PROM_NB)
		return 1;
	else
		return 0;
}

/*====================================================================================================*/
/*====================================================================================================*
**函数原型 : void MS5611_Read_Adc_Temperature(void)
**功    能 : 读取MS5611的24位温度ADC
**输    入 : None
**输    出 : None
**备    注 : 
**====================================================================================================*/
/*====================================================================================================*/
void MS5611_Read_Adc_Temperature(void)
{
	MS5611_ReadRegister(CMD_ADC_READ, temp_rxbuf,3 ); // read ADC
}


/*====================================================================================================*/
/*====================================================================================================*
**函数原型 : void MS5611_Read_Adc_Pressure(void)
**功    能 : MS5611的压力值读取
**输    入 : None
**输    出 : None
**备    注 : 
**====================================================================================================*/
/*====================================================================================================*/
void MS5611_Read_Adc_Pressure(void)
{
	MS5611_ReadRegister(CMD_ADC_READ,press_rxbuf,3); // read ADC
}


/*====================================================================================================*/
/*====================================================================================================*
**函数原型 : void MS5611_Start_Temperature(void)
**功    能 : 开始转换
**输    入 : None
**输    出 : None
**备    注 : 
**====================================================================================================*/
/*====================================================================================================*/

void MS5611_Start_Temperature(void)
{
	MS5611_WriteRegister(CMD_ADC_CONV + CMD_ADC_D2 + MS5611_OSR, 0x01); // D2 (temperature) conversion start!
}

/*====================================================================================================*/
/*====================================================================================================*
**函数原型 : void MS5611_Start_Press(void)
**功    能 : 压力开始转换
**输    入 : None
**输    出 : None
**备    注 : 
**====================================================================================================*/
/*====================================================================================================*/
void MS5611_Start_Press(void)
{
  MS5611_WriteRegister(CMD_ADC_CONV + CMD_ADC_D1 + MS5611_OSR, 0x01); // D1 (pressure) conversion start!
}





/*====================================================================================================*/
/*====================================================================================================*
**函数原型 : void MS5611_BaroAltCalculate(void)
**功    能 : 计算
**输    入 : None
**输    出 : None
**备    注 : 
**====================================================================================================*/
/*====================================================================================================*/
float temperature_5611;
extern int32_t ms5611_pressure;
void MS5611_BaroAltCalculate(void)
{
	static u8 baro_start;
	
  int32_t temperature, off2 = 0, sens2 = 0, delt;
  int32_t pressure;
	float alt_3;
	
	int32_t dT;
	int64_t off;
	int64_t sens;
	
	static vs32 sum_tmp_5611 = 0;
	static u8 sum_cnt = BARO_CAL_CNT + 10;
	
	ms5611_ut = (temp_rxbuf[0] << 16) | (temp_rxbuf[1] << 8) | temp_rxbuf[2];
	ms5611_up = (press_rxbuf[0] << 16) | (press_rxbuf[1] << 8) | press_rxbuf[2];
		
    dT = ms5611_ut - ((uint32_t)ms5611_prom[5] << 8);
    off = ((uint32_t)ms5611_prom[2] << 16) + (((int64_t)dT * ms5611_prom[4]) >> 7);
    sens = ((uint32_t)ms5611_prom[1] << 15) + (((int64_t)dT * ms5611_prom[3]) >> 8);
    temperature = 2000 + (((int64_t)dT * ms5611_prom[6]) >> 23);

    if (temperature < 2000)  // temperature lower than 20degC 
	{ 
			// temperature lower than 20degC
        delt = temperature - 2000;
        delt = 5 * delt * delt;
        off -= delt >> 1;
        sens -= delt >> 2;
        if (temperature < -1500) 
				{ // temperature lower than -15degC
            delt = temperature + 1500;
            delt = delt * delt;
            off -= 7 * delt;
            sens -= (11 * delt) >> 1;
        }
      temperature -= ((dT * dT) >> 31);
    }
		
    pressure = (((ms5611_up * sens ) >> 21) - off) >> 15;
	
	 ms5611_pressure = pressure;

	temperature_5611=temperature;

}

/*====================================================================================================*/
/*====================================================================================================*
**函数原型 : int32_t MS5611_Get_BaroAlt(void)
**功    能 : 获得气压计算的高度
**输    入 : None
**输    出 : None
**备    注 : 
**====================================================================================================*/
/*====================================================================================================*/
int32_t MS5611_Get_BaroAlt(void)
{
	return baroAlt;
}


/*====================================================================================================*/
/*====================================================================================================*
**函数原型 : uint8_t MS5611_WriteRegister(uint8_t reg,uint8_t data)
**功    能 : 配置写寄存器
**输    入 : None
**输    出 : None
**备    注 : 
**====================================================================================================*/
/*====================================================================================================*/

uint8_t MS5611_WriteRegister(uint8_t reg,uint8_t data)
{
	 uint8_t status;
	/*置低CSN，使能SPI传输*/
    MS5611_ON_CS() ;
				
	/*发送命令及寄存器号 */
	status = SPI4_ReadWriteByte(reg);
		 
	 /*向寄存器写入数据*/
    SPI4_ReadWriteByte(data); 
	          
	/*CSN拉高，完成*/	   
  	MS5611_OFF_CS();	
		
	/*返回状态寄存器的值*/
   	return(status);
	
}


/*====================================================================================================*/
/*====================================================================================================*
**函数原型 : uint8_t MS5611_ReadRegister(uint8_t reg, uint8_t *data,uint8_t length)
**功    能 : 配置读寄存器
**输    入 : None
**输    出 : None
**备    注 : 
**====================================================================================================*/
/*====================================================================================================*/
uint8_t MS5611_ReadRegister(uint8_t reg, uint8_t *data,uint8_t length)
{
	uint8_t reg_val;
	MS5611_ON_CS();
	HAL_SPI_Transmit(&SPI4_Handler,&reg,1,100); 
	reg=0x0f;
	reg_val=HAL_SPI_TransmitReceive(&SPI4_Handler,&reg,data,length,100);
	MS5611_OFF_CS();
  return reg_val;
}


/***********************************************************************************************************
*                               NoneQuadrotor UAV file_end
***********************************************************************************************************/


