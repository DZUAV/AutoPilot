/**********************************************************************************************************
*文件说明：RGBLED驱动文件配置函数
*实现功能：配置点亮rgbled
*修改日期：2018-11-26
*修改作者：crystal cup
*修改备注：
**********************************************************************************************************/
#include "drv_sbus.h" 
#include "copter.h"


int sbus_channel[12]={0};
/**********************************************************************************************************
*函数原型: void Sbus_Init(void)
*函数功能: sbus初始化
*输入参数: none
*返回数据: none
*修改日期: 2018-12-15
*备注信息：
**********************************************************************************************************/
void Sbus_Init(void)
{
   USART3_init(108,100000);//sbus串口波特率初始化
}

/**********************************************************************************************************
*函数原型: void Sbus_Parser(void)
*函数功能: 解析SBUS数据
*输入参数: none
*返回数据: none
*修改日期: 2018-12-15
*备注信息：[startbyte] [data1][data2][data22][flags][endbyte] 
*          协议的开始是0x0f,结束字节是0x00
*          j=0,i=0---7
*          bin[0],bin[1],...bin[7]
*          j=1,i=0---7
*          bin[8],bin[9],...bin[15]
*          j=2,i=0---7
*          bin[16],bin[17],...bin[23]
*          j=3,i=0---7
*          bin[24],bin[25],...bin[31]
*          j=4,i=0---7
*          bin[32],bin[33],...bin[39]
*          j=5,i=0---7
*          bin[40],bin[41],...bin[47]
*          j=6,i=0---7
*          bin[48],bin[1],...bin[55]
*          j=7,i=0---7
*          bin[56],bin[9],...bin[63]
**********************************************************************************************************/
void Sbus_Parser(void)
{
  int i,j;
	char bin[300]={0};
	uint8_t temp=0;
	
	if(USART3_rx_buf[0] == 0x0F && USART3_rx_len==25) 
	{
		for(j=0;j<22;j++)
		{
			temp = USART3_rx_buf[j+1]; //开始接收数据USART3_rx_buf[1],USART3_rx_buf[2],...USART3_rx_buf[22]
			
			for(i=0;i<8;i++)
			{
				bin[i+j*8] = ((temp>>i)&0x01) ? '1' : '0'; //bin[0],bin[1],...bin[7]
			}
		}
		
		memset(sbus_channel,0,12); //设置sbus_channel全部等于0 
		
		for(j=0;j<12;j++) //得到12位数据
		{
			for(i=0;i<11;i++)
			{
				if(bin[j*11+i]=='1')
				{
					sbus_channel[j] |= (1<<i);
				}
				else
				{
					sbus_channel[j] &= ~(1<<i); //得到12位数据
				}
			}
		}
	}
	
	USART3_rx_len = 0;

}

/**********************************************************************************************************
*函数原型: int sbus_get_data(int ch_num)
*函数功能: 解析SBUS数据
*输入参数: none
*返回数据: none
*修改日期: 2018-12-15
*备注信息：
**********************************************************************************************************/
int sbus_get_data(int ch_num)
{
	if(ch_num > 0 && ch_num<=12)
	{
		return sbus_channel[ch_num-1];
	}
	
	return 0;
}
/**********************************************************************************************************
*函数原型: void HAL_SYSTICK_Callback(void)
*函数功能: 解析SBUS数据用到的系统中断回调函数
*输入参数: none
*返回数据: none
*修改日期: 2018-12-15
*备注信息：
**********************************************************************************************************/
static int time_count=0;
void HAL_SYSTICK_Callback(void)
{	
	timer_cb();
	time_count++;
}

/**********************************************************************************************************
*函数原型: void timer_cb(void)
*函数功能: 
*输入参数: none
*返回数据: none
*修改日期: 2018-12-15
*备注信息：
**********************************************************************************************************/
void timer_cb(void)
{
	USART3_count++;
	
	if(USART3_count==2)
	{
		USART3_rx_flag = 1;
		Sbus_Parser();
	}
}
/***********************************************************************************************************
*                               NoneQuadrotor UAV file_end
***********************************************************************************************************/

